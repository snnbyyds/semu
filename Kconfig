## Kconfig
```kconfig
mainmenu "SEMU Configuration Menu"

source "src/memory/Kconfig"
source "src/device/Kconfig"

menu "Build Options"
choice
  prompt "Compiler"
  default CC_CLANG
config CC_GCC
  bool "gcc"
config CC_GPP
  bool "g++"
config CC_CLANG
  bool "clang"
endchoice

config CC
  string
  default "gcc" if CC_GCC
  default "g++" if CC_GPP
  default "clang" if CC_CLANG
  default "none"

choice
  prompt "Optimization Level"
  default CC_O2
config CC_O0
  bool "O0"
config CC_O1
  bool "O1"
config CC_O2
  bool "O2"
config CC_O3
  bool "O3"
endchoice

config CC_OPT
  string
  default "-O0" if CC_O0
  default "-O1" if CC_O1
  default "-O2" if CC_O2
  default "-O3" if CC_O3
  default "none"

config CC_LTO
  depends on !TARGET_AM
  bool "Enable link-time optimization"
  default n

config CC_DEBUG
  bool "Enable debug information"
  default n

config CC_ASAN
  bool "Enable address sanitizer"
  default n
endmenu

source "src/monitor/Kconfig"
source "src/utils/trace/Kconfig"
```

## configs/riscv32-ref_defconfig
```kconfig
CONFIG_TARGET_SHARE=y
CONFIG_CC_O3=y
CONFIG_CC_LTO=y
# CONFIG_RUNTIME_CHECK is not set
```

## src/device/Kconfig
```kconfig
menu "Device Configurations"

config MMIO_SPACE_SIZE
  hex "IO Space Size"
  default 0x2000000

menu "Serial"
config SERIAL_MMIO
  hex "MMIO address of serial device"
  default 0xa00003f8
endmenu

menu "Timer"
config TIMER_MMIO
  hex "MMIO address of timer device"
  default 0xa0000048
endmenu

menu "VGA"
config VGA_MMIO
  hex "MMIO address of VGA controller"
  default 0xa0000100

config FB_ADDR
  hex "MMIO address of framebuffer"
  default 0xa1000000
endmenu

menu "Keyboard"
config KBD_MMIO
  hex "MMIO address of Keyboard device"
  default 0xa0000080
endmenu

menu "Audio"
config AUDIO_CTL_MMIO
  hex "MMIO address of audio controller"
  default 0xa0000200

config SB_ADDR
  hex "MMIO address of sound buffer"
  default 0xa1200000

config SB_SIZE
  hex "Size of sound buffer"
  default 0x10000
endmenu

menu "DISK"
config DISK_CTL_MMIO
  hex "MMIO address of the disk controller"
  default 0xa0000300

config DISK_BLK_SZ
  hex "Size of disk blk"
  default 0x200

config DB_ADDR
  hex "MMIO address of the disk blk buffer"
  default 0xa1300000
endmenu

endmenu
```

## src/memory/Kconfig
```kconfig
menu "Memory Configurations"

config MBASE
  hex "Memory Base"
  default 0x80000000

config MSIZE
  hex "Memory Size"
  default 0x8000000

config RESET_VECTOR
  hex "PC reset vector"
  default 0x80000000

config ENABLE_TLB
  bool "Enable TLB"
  default n

endmenu
```

## src/monitor/Kconfig
```kconfig
config USE_GDBSTUB
  bool "Use gdb instead of sdb"
  default n
  help
    Start GDBSTUB

config PAUSE_PC
  bool "Allow pause at a set PC"
  default n
  help
    Allow pause at a set PC
```

## src/utils/difftest/Kconfig
```kconfig
menuconfig DIFFTEST
  bool "Enable difftest"
  default n

if DIFFTEST
choice ENABLE_DIFFTEST
  prompt "Reference design"
  default DIFFTEST_REF_SPIKE
  depends on DIFFTEST
config DIFFTEST_REF_NEMU
  bool "NEMU"
config DIFFTEST_REF_SPIKE
  bool "Spike"
endchoice

config DIFFTEST_REF_PATH
  string
  default "tools/nemu-diff/repo" if DIFFTEST_REF_NEMU
  default "tools/spike-diff" if DIFFTEST_REF_SPIKE
  default "none"

config DIFFTEST_REF_NAME
  string
  default "riscv32-nemu-interpreter-so" if DIFFTEST_REF_NEMU
  default "riscv32-spike-so" if DIFFTEST_REF_SPIKE
  default "none"
endif
```

## src/utils/trace/Kconfig
```kconfig
menuconfig ENABLE_TRACE
  bool "Enable traces"
  default n

if ENABLE_TRACE
config ENABLE_ITRACE
  bool "Enable instruction trace"
  default n

config ENABLE_ETRACE
  bool "Enable etrace"
  default n
endif
```
